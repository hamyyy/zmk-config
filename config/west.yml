## config/west.yml
```yaml
manifest:
  remotes:
    - name: hamyyy
      url-base: https://github.com/hamyyy
    # Additional modules containing boards/shields/custom code can be listed here as well
    # See https://docs.zephyrproject.org/3.2.0/develop/west/manifest.html#projects
  projects:
    - name: zmk
      remote: hamyyy
      revision: main
      import: app/west.yml
  self:
    path: config
```
